## mm/asynczero/Kconfig
```kconfig
# SPDX-License-Identifier: GPL-2.0-only

config ASYNCZERO
	tristate "Adds the asynczero module."
	default m
	depends on MEMCG && TRANSPARENT_HUGEPAGE
	help
	  Adds the asynczero module.
```

## mm/kbadgerd/Kconfig
```kconfig
# SPDX-License-Identifier: GPL-2.0-only

config KBADGERD
	tristate "Adds the kbadgerd module."
	default m
	help
	  Adds the kbadgerd module.
```
